## firmware/components/board/Kconfig.projbuild
```kconfig
menu "Dot: Board"

    choice DOT_BOARD
        prompt "Display board"
        default DOT_BOARD_LCD_2_1
        help
            The hardware the firmware runs on. Selects the panel, touch and
            power drivers that are built.

        config DOT_BOARD_LCD_2_1
            bool "Waveshare ESP32-S3-Touch-LCD-2.1"

        config DOT_BOARD_AMOLED_2_16
            bool "Waveshare ESP32-S3-Touch-AMOLED-2.16"
    endchoice

    config DOT_AUTO_ROTATE
        bool "Auto-rotate the display with the accelerometer"
        default y
        depends on DOT_BOARD_AMOLED_2_16
        help
            Turn the picture, and the touch input with it, to follow how the
            board is held. Needs the onboard QMI8658 accelerometer. Turn off to
            keep the display in its default orientation.

    config DOT_IDLE_DIM_SECONDS
        int "Dim the display after this many idle seconds (0 = never)"
        default 300
        range 0 86400
        depends on DOT_BOARD_AMOLED_2_16
        help
            A lit AMOLED pixel wears out, and apps like ci hold one color for
            hours. After this long without a touch the display dims, and the
            next touch brings it back. Serial data from the host does not count
            as activity.

    config DOT_IDLE_DIM_PERCENT
        int "Brightness when dimmed, in percent"
        default 15
        range 0 100
        depends on DOT_BOARD_AMOLED_2_16 && DOT_IDLE_DIM_SECONDS > 0

endmenu
```

## main/Kconfig.projbuild
```kconfig
menu "Example Configuration"
    config WIFI_SSID
        string "WiFi SSID"
        default "your_ssid"
        help
            SSID of the Wi-Fi network to connect to.

    config WIFI_PASSWORD
        string "WiFi Password"
        default "your_password"
        help
            Password of the Wi-Fi network.

    config UDP_PORT
        int "UDP listen port"
        default 3333
        help
            UDP port the ESP32 listens on for CPU data.
    config EXAMPLE_DOUBLE_FB
        bool "Use double Frame Buffer"
        default "n"
        help
            Enable this option, driver will allocate two frame buffers.

    config EXAMPLE_USE_BOUNCE_BUFFER
        depends on !EXAMPLE_DOUBLE_FB
        bool "Use bounce buffer"
        help
            Enable bounce buffer mode can achieve higher PCLK frequency at the cost of higher CPU consumption.

    config EXAMPLE_AVOID_TEAR_EFFECT_WITH_SEM
        depends on !EXAMPLE_DOUBLE_FB
        bool "Avoid tearing effect"
        default "y"
        help
            Enable this option, the example will use a pair of semaphores to avoid the tearing effect.

    config BT_ENABLED
        bool "Select this option to enable Bluetooth"
        default y

    config BT_BLE_50_FEATURES_SUPPORTED
        bool "Enabling this option activates BLE 5.0 features"
        default y

    config BT_BLE_42_FEATURES_SUPPORTED
        bool "This enables BLE 4.2 features."
        default y
endmenu
```
